## CMakeLists.txt
```
cmake_minimum_required(VERSION 3.20.0)

set(ZEPHYR_EXTRA_MODULES ${CMAKE_CURRENT_SOURCE_DIR}/modules/power_switch)

find_package(Zephyr REQUIRED HINTS $ENV{ZEPHYR_BASE})
project(power_switch_app)

target_sources(app PRIVATE src/main.c)
```

## prj.conf
```kconfig
CONFIG_GPIO=y
CONFIG_POWER_SWITCH=y
CONFIG_LOG=y
CONFIG_PRINTK=y
```

## boards/blackpill_f401cc.overlay
```dts
/ {
    power_switches: power_switches {
        compatible = "power-switch";
        status = "okay";
        gpios = <&gpioa 5 GPIO_ACTIVE_HIGH>;
    };
};
```

## src/main.c
```c
#include <zephyr/kernel.h>
#include <zephyr/device.h>
#include <zephyr/devicetree.h>
#include "drivers/power_switch.h"

#define PWR_SW_NODE DT_NODELABEL(power_switches)

int main(void){
    const struct device *pwr = DEVICE_DT_GET(PWR_SW_NODE);

    if(!device_is_ready(pwr)){
        printk("Power switch not ready!\n");
        return -1;
    }

    while(1){
        power_switch_on(pwr);
        k_msleep(500);
        power_switch_off(pwr);
        k_msleep(500);
    }
    return 0;
}
```
