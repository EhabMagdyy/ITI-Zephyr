## 04-Module/modules/power_switch/Kconfig
```kconfig
config POWER_SWITCH
    bool "Power Switch GPIO driver"
    default y
    depends on GPIO
    depends on DT_HAS_POWER_SWITCH_ENABLED
    help
      Enable the GPIO-based power switch driver.
```

## 04-Module/modules/power_switch/dts/bindings/power-switch.yaml
```yaml
description: GPIO-controlled power switch

compatible: "power-switch"

properties:
  gpios:
    type: phandle-array
    required: true
    description: GPIO pin controlling the power switch.
```

## 04-Module/power_switch_project/modules/power_switch/dts/bindings/power-switch.yaml
```yaml
description: GPIO-controlled power switch

compatible: "power-switch"

include: base.yaml

properties:
  gpios:
    type: phandle-array
    required: true
    description: GPIO pin controlling the power switch.

  startup-delay-ms:
    type: int
    default: 0
    description: Delay after power-on in milliseconds.
```
